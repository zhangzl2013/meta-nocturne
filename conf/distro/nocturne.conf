## conf/distro/nocturne.conf
```bitbake
DISTRO = "nocturne"
DISTRO_NAME = "Nocturne (Nocturne Distro)"
DISTRO_VERSION = "1.0"
DISTRO_CODENAME = "zeus"
SDK_VENDOR = "-nocturnesdk"
SDK_VERSION = "${@d.getVar('DISTRO_VERSION').replace('snapshot-${DATE}', 'snapshot')}"

MAINTAINER = "Zhaolong Zhang <zhangzl2013@126.com>"

TARGET_VENDOR = "-nocturne"

LOCALCONF_VERSION = "1"

DISTRO_VERSION[vardepsexclude] = "DATE"
SDK_VERSION[vardepsexclude] = "DATE"

# Override these in nocturne based distros
NOCTURNE_DEFAULT_DISTRO_FEATURES = "largefile multiarch"
NOCTURNE_DEFAULT_EXTRA_RDEPENDS = "packagegroup-core-boot"
NOCTURNE_DEFAULT_EXTRA_RRECOMMENDS = "kernel-module-af-packet"

DISTRO_FEATURES ?= "${DISTRO_FEATURES_DEFAULT} ${NOCTURNE_DEFAULT_DISTRO_FEATURES}"

PREFERRED_VERSION_linux-yocto ?= "5.2%"

SDK_NAME = "${DISTRO}-${TCLIBC}-${SDKMACHINE}-${IMAGE_BASENAME}-${TUNE_PKGARCH}-${MACHINE}"
SDKPATH = "/opt/${DISTRO}/${SDK_VERSION}"

DISTRO_EXTRA_RDEPENDS += " ${NOCTURNE_DEFAULT_EXTRA_RDEPENDS}"
DISTRO_EXTRA_RRECOMMENDS += " ${NOCTURNE_DEFAULT_EXTRA_RRECOMMENDS}"

NOCTURNEQEMUDEPS = "${@bb.utils.contains("INCOMPATIBLE_LICENSE", "GPL-3.0", "", "packagegroup-core-device-devel",d)}"
DISTRO_EXTRA_RDEPENDS_append_qemuarm = " ${NOCTURNEQEMUDEPS}"
DISTRO_EXTRA_RDEPENDS_append_qemuarm64 = " ${NOCTURNEQEMUDEPS}"
DISTRO_EXTRA_RDEPENDS_append_qemumips = " ${NOCTURNEQEMUDEPS}"
DISTRO_EXTRA_RDEPENDS_append_qemuppc = " ${NOCTURNEQEMUDEPS}"
DISTRO_EXTRA_RDEPENDS_append_qemux86 = " ${NOCTURNEQEMUDEPS}"
DISTRO_EXTRA_RDEPENDS_append_qemux86-64 = " ${NOCTURNEQEMUDEPS}"

TCLIBCAPPEND = ""

SANITY_TESTED_DISTROS ?= " \
            ubuntu-16.04 \n \
            ubuntu-18.04 \n \
            ubuntu-19.04 \n \
            fedora-28 \n \
            fedora-29 \n \
            fedora-30 \n \
            centos-7 \n \
            debian-8 \n \
            debian-9 \n \
            debian-10 \n \
            opensuseleap-15.1 \n \
            "
#
# OELAYOUT_ABI allows us to notify users when the format of TMPDIR changes in
# an incompatible way. Such changes should usually be detailed in the commit
# that breaks the format and have been previously discussed on the mailing list
# with general agreement from the core team.
#
OELAYOUT_ABI = "1"

# QA check settings - a little stricter than the OE-Core defaults
WARN_TO_ERROR_QA = "already-stripped compile-host-path install-host-path \
                    installed-vs-shipped ldflags pn-overrides rpaths staticdev \
                    unknown-configure-option useless-rpaths"
WARN_QA_remove = "${WARN_TO_ERROR_QA}"
ERROR_QA_append = " ${WARN_TO_ERROR_QA}"

require conf/distro/include/no-static-libs.inc
require conf/distro/include/yocto-uninative.inc
require conf/distro/include/security_flags.inc
INHERIT += "uninative"
```

## conf/layer.conf
```bitbake
# We have a conf and classes directory, add to BBPATH
BBPATH =. "${LAYERDIR}:"

# We have recipes-* directories, add to BBFILES
BBFILES += "${LAYERDIR}/recipes-*/*/*.bb \
            ${LAYERDIR}/recipes-*/*/*.bbappend"

BBFILE_COLLECTIONS += "nocturne"
BBFILE_PATTERN_nocturne = "^${LAYERDIR}/"
BBFILE_PRIORITY_nocturne = "100"

LAYERSERIES_COMPAT_nocturne = "zeus"

# This should only be incremented on significant changes that will
# cause compatibility issues with other layers
LAYERVERSION_nocturne = "1"

LAYERDEPENDS_nocturne = "core"

REQUIRED_NOCTURNE_BBLAYERS_CONF_VERSION = "1"
```
